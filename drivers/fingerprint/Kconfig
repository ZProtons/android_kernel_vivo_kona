## drivers/fingerprint/Kconfig
```kconfig
menu "BBK FINGERPRINT support"
config BBK_FINGERPRINT
	tristate "BBK FINGERPRINT support"
	help
	  Say Y here to enable switch class support.

if BBK_FINGERPRINT

config BBK_FP_ID
	tristate "BBK FP ID support"
	help
	  Say Y here to enable switch class support.

config BBK_FP_HBM_INPUT
	tristate "BBK FP HBM INPUT support"
	help
	  Say Y here to enable switch class support.
endif

source "drivers/fingerprint/gf9518/Kconfig"
source "drivers/fingerprint/gf3208/Kconfig"
source "drivers/fingerprint/fpc1511/Kconfig"
endmenu
```

## drivers/fingerprint/fpc1511/Kconfig
```kconfig
config BBK_FPC1511
	tristate "FPC OEM fingerprint FPC1511 support"
	help
	  there is nothing for help!  
```

## drivers/fingerprint/gf3208/Kconfig
```kconfig
config BBK_GOODIX3208
	tristate "Goodix GF3208 fingerprint drvier support"
	help
	  Say Y here to enable goodix fingerprint driver support!
```

## drivers/fingerprint/gf9518/Kconfig
```kconfig
config BBK_GF9518
	tristate "Goodix GF9518 fingerprint drvier support"
	help
	  Say Y here to enable goodix fingerprint driver support!
```

## drivers/misc/vibrator/Kconfig
```kconfig
config HAPTICS_CORE
    tristate "VIVO Haptics CORE support"
    depends on I2C
    help
        This option enables vibrator class driver support for not input-ff framework vibrator driver.
        Mainly used for the third party peripheral chip.
```

## drivers/misc/vibrator/aw86917/Kconfig
```kconfig
config AW86917_HAPTICS
    tristate "AWINIC High Voltage Haptics support"
    depends on LEDS_CLASS
    depends on I2C
    help
        This option enables device driver support for the high voltage haptics
        peripheral aw86917
```

## drivers/power/Kconfig
```kconfig
source "drivers/power/avs/Kconfig"
source "drivers/power/reset/Kconfig"
source "drivers/power/supply/Kconfig"
source "drivers/power/vivo_power_debug/Kconfig"
```

## drivers/power/supply/qcom/Kconfig
```kconfig
# SPDX-License-Identifier: GPL-2.0-only

menu "Qualcomm Technologies, Inc. Charger and Fuel Gauge support"

config QPNP_SMB2
        tristate "SMB2 Battery Charger"
        depends on MFD_SPMI_PMIC
        help
          Say Y to enables support for the SMB2 charging peripheral.
          The QPNP SMB2 charger driver supports the charger peripheral
          present in the PMICOBALT chip.
          The power supply framework is used to communicate battery and
          usb properties to userspace and other driver consumers such
          as fuel gauge, USB, and USB-PD.
          VBUS and VCONN regulators are registered for supporting OTG,
          and powered Type-C cables respectively.

config BATTERY_BQ27750
	tristate "BQ27750 battery driver"
	depends on I2C
	help
	  Say Y here to enable support for batteries with BQ28Z61 (I2C) chips.
	  The BQ28Z61 Texas Instruments Inc device monitors the battery
	  charging/discharging status via Rsens resistor, typically 10 mohm.
	  It monitors the battery temperature via Thermistor.
	  The device monitors the battery level (Relative-State-Of-Charge).
	  The device is SBS compliant, providing battery info over I2C.

config QPNP_SMB5
	tristate "SMB5 Battery Charger"
	depends on MFD_SPMI_PMIC
	help
	  Say Y to enables support for the SMB5 charging peripheral.
	  The QPNP SMB5 charger driver supports the charger peripheral
	  present in the chip.
	  The power supply framework is used to communicate battery and
	  usb properties to userspace and other driver consumers such
	  as fuel gauge, USB, and USB-PD.
	  VBUS and VCONN regulators are registered for supporting OTG,
	  and powered Type-C cables respectively.

config QPNP_SMBLITE
	tristate "SMBLITE Battery Charger"
	depends on MFD_SPMI_PMIC
	help
	  Say Y to enables support for the SMBLITE charging peripheral.
	  The QPNP SMBLITE charger driver supports the charger peripheral
	  present in the chip.
	  The power supply framework is used to communicate battery and
	  usb properties to userspace and other driver consumers such
	  as fuel gauge and USB.
	  VBUS regulator is registered for supporting OTG.

config SMB138X_CHARGER
	tristate "SMB138X Battery Charger"
	depends on MFD_I2C_PMIC
	help
	  Say Y to include support for SMB138X Battery Charger.
	  SMB1380 is a dual phase 6A battery charger, and SMB1381 is a single
	  phase 5A battery charger.
	  The driver supports charger enable/disable.
	  The driver reports the charger status via the power supply framework.
	  A charger status change triggers an IRQ via the device STAT pin.

config SMB1390_CHARGE_PUMP_PSY
	tristate "SMB1390 power supply framework based driver"
	depends on MFD_I2C_PMIC
	help
	  Say Y to include support for SMB1390 Charge Pump driver based on
	  power supply framework.
	  SMB1390 is a div2 charge pump capable of delivering 6A charge current
	  with very high efficiency. It can work either as 2s to 1s
	  pre-regulator or as a companion charger when paired with Qualcomm
	  Technologies, Inc.’s family of standalone chargers to enable a high
	  current, low profile Li+ battery charging system.

config SMB1351_USB_CHARGER
        tristate "smb1351 usb charger (with VBUS detection)"
        depends on I2C
        help
         Say Y to enable support for the SMB1351 switching mode based charger.
         The driver supports charging control (enable/disable) and
         charge-current limiting. It also provides USB VBUS detection and
         notification support. The driver controls SMB1351 via I2C and
         supports device-tree interface.

config SMB1355_SLAVE_CHARGER
	tristate "SMB1355 Slave Battery Charger"
	depends on MFD_I2C_PMIC
	help
	  Say Y to include support for SMB1355 Battery Charger.
	  SMB1355 is a single phase 5A battery charger.
	  The driver supports charger enable/disable.
	  The driver reports the charger status via the power supply framework.
	  A charger status change triggers an IRQ via the device STAT pin.

config QPNP_QNOVO5
	bool "QPNP QNOVO5 driver"
	depends on MFD_SPMI_PMIC
	help
	  Say Y here to enable the Qnovo5 PBS-based pulse charging engine.
	  Qnovo5 driver accepts pulse parameters via sysfs entries and programs
	  the hardware module. It also allows userspace code to read diagnostics
	  of voltage and current measured during certain phases of the pulses.

config QPNP_FG_GEN3
        tristate "QPNP GEN3 fuel gauge driver"
        depends on MFD_SPMI_PMIC
        help
          Say Y here to enable the GEN3 Fuel Gauge driver. This adds support
          for battery fuel gauging and state of charge of battery connected to
          the fuel gauge. The state of charge is reported through a BMS power
          supply property and also sends uevents when the capacity is updated.

config QPNP_FG_GEN4
	tristate "QPNP GEN4 fuel gauge driver"
	depends on MFD_SPMI_PMIC
	help
	  Say Y here to enable the GEN4 Fuel Gauge driver. This adds support
	  for battery fuel gauging and state of charge of battery connected to
	  the device that has QTI PMICs like PM8150B. The state of charge is
	  reported through a BMS power supply property and also sends uevents
	  when the capacity is updated.

config QPNP_QG
	bool "QPNP Qgauge driver"
	depends on MFD_SPMI_PMIC
	help
	  Say Y here to enable the Qualcomm Technologies, Inc. QGauge driver
	  which uses the periodic sampling of the battery voltage and current
	  to determine the battery state-of-charge (SOC) and supports other
	  battery management features.

config HL6111R
	bool "HL6111R driver"
	depends on I2C && OF
	select REGMAP_I2C
	help
	  Say Y here to enable the Halo Microelectronics HL6111R driver.
	  HL6111R is a wireless charging power receiver IC that supports the
	  A4WP wireless charging power delivery standard. It supports up to
	  15W, and the output voltage can be programmed with variable step
	  sizes. The HL6111R has voltage, current and temperature
	  protection mechanisms, an I2C interface, and a PSNS output.

config SMB1398_CHARGER
	tristate "SMB1398 power supply framework based driver"
	depends on MFD_I2C_PMIC
	help
	  Say Y to include the support of SMB1398 Charge driver based on power
	  supply framework.
	  SMB1398 is a combo charger chip which can work in different modes:
	  (1) DIV2 charge pump mode to work as a companion charger to be paired
	      with Qualcomm Technologies, Inc.’s family of standalone chargers;
	  (2) DIV2 and 3-level buck combo mode to regulate the output power from
	      wireless charger receiver and provide the input for downstream
	      chargers.

config STM32l011X4
	tristate "STM32l011X4 driver"
	depends on I2C
	default n
	help
	  Say Y here to enable support for STM32l011X4.
config BATTERY_DETECT
	bool "battery protect"
	help
	  Say Y here to enable.
config FUEL_SUMMARY
	tristate "VIVO FUEL SUMMARY"
	help
	  Say Y to enable support for the FUEL SUMMARY
	  
config WIRELESS_RX_MAXIC_MT5725
	tristate "MAXIC Wireless Charger RX IC"
	help
	  Say Y to enable support for the MAXIC MT5725_WPC_RX
config BOOST_CHARGER_BQ25790
	tristate "TI BQ2579X battery charger driver"
	depends on I2C
	help
	  Say Y to enable support for TI bq2579x charger

config DIALOG_DA9313_DIVIDER
	tristate "Da9313 driver"
	depends on I2C
	default n
	help
	  Say Y here to enable support for Da9313 High Efficiency Dual Cell Switched Capacitor Divider.
	  General Description:
		DA9313 is a high-voltage power converter with a maximum output current of 10 A, suitable for 
		applications supplied from a dual (2S) Li-ion or Li-polymer stacked cell battery pack, or any input 
		voltage between 5 V and 10.5 V. The converter operates with efficiency during conversion of up to 
		98 %. Master/slave operation is offered, where a pair of devices can combine to double the peak 
		output current to 20 A. 
		Low profile external components and a minimum PCB footprint allow small circuit implementation in 
		compact applications. The pass devices are fully integrated therefore no external FETs are needed.  
		DA9313 utilizes a programmable soft start to limit the inrush current from the input node and secure 
		a slope controlled activation of the rails. It also implements integrated over-temperature and over-
		current protection for increased system reliability without the need for external sensing components. 
		Enable, low power mode entry and exit, and power good signals are available at configurable ports 
		flexibly supporting different applications and power-up or power-down scenarios.
endmenu
```

## drivers/power/vivo_power_debug/Kconfig
```kconfig
config VIVO_POWER_DEBUG
	bool "VIVO Power Debug Feature"
	default y
	help
	  VIVO Power Debug Feature
```

## drivers/soc/vivo/src/Kconfig
```kconfig
config VIVO_BOARDINFO
        bool "vivo Board information support"
        help
          enable vivo Board information support on qcom platform
```
